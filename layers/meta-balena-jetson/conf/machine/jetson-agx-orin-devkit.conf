## layers/meta-balena-jetson/conf/machine/jetson-agx-orin-devkit.conf
```bitbake
#@TYPE: Machine
##@NAME: jetson-agx-orin-devkit
##@DESCRIPTION: Machine configuration for the Kiwi Xavier Carrier Board for NVidia Jetson Xavier

MACHINEOVERRIDES = "jetson-agx-orin-devkit:${MACHINE}"
include conf/machine/jetson-agx-orin-devkit.conf

ODMDATA ?= "gbe-uphy-config-0,hsstp-lane-map-3,nvhs-uphy-config-0,hsio-uphy-config-16"
MACHINEOVERRIDES := "${@'${MACHINEOVERRIDES}'.replace(':${MACHINE}',':jetson-agx-orin-devkit:${MACHINE}')}"
```
